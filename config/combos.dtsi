/*                KEY POSITIONS
  ╭─────────────────────╮ ╭─────────────────────╮
  │  00  01  02  03  04 │ │  05  06  07  08  09 │
  │  10  11  12  13  14 │ │  15  16  17  18  19 │
  │  20  21  22  23  24 │ │  25  26  27  28  29 │
  ╰───────╮  30  31  32 │ │  33  34  35 ╭───────╯
          ╰─────────────╯ ╰─────────────╯ */

#define ALL 0xff
#define COMBO_TAB_MS 25
// use global-quick-tap-ms for combos (requires PR 1387)
#define COMBO_HOOK global-quick-tap-ms = <75>;

// just for drawing purposes
#ifndef DUMMY_KEEB
#define DUMMY_KEEB 0
#endif

/ {
    combos {
        compatible = "zmk,combos";
#define CONCAT2(x, y) x ## y
#define CONCAT(x, y) CONCAT2(x, y)
#define COMBO(name, pos, k, l) CONCAT(combo_, name) { key-positions = <pos>; bindings = <k>; layers = <l>; timeout-ms = <COMBO_TAB_MS>; };

//Basics	
	COMBO(esc, 21 22, &kp ESC, BASE BASE_B)
	COMBO(tab, 22 23, &kp TAB, BASE BASE_B)
	COMBO(lenter, 21 22 23, &kp ENTER, BASE BASE_B)
	COMBO(renter, 26 27 28, &kp ENTER, BASE BASE_B)
	COMBO(backspace, 26 27, &kp BSPC, BASE BASE_B)
	COMBO(delete, 27 28, &kp DEL, BASE BASE_B)
	COMBO(bword, 26 28, &kp RC(BSPC), BASE BASE_B)
//Punctuation
	COMBO(quotemark, 17 19, &kp SQT, BASE BASE_B)
	COMBO(lbracket, 3 13, &kp LBKT, BASE)
	COMBO(rbracket, 6 16, &kp RBKT, BASE)

//Buggy
	COMBO(slash, 18 19, &kp SLASH, BASE_B)
	COMBO(blbracket, 13 23, &kp LBKT, BASE_B)
	COMBO(brbracket, 16 26, &kp RBKT, BASE_B)
	COMBO(bcolon, 17 27, &kp SEMI, BASE_B)
	COMBO(bpipe, 18 28, &kp BSLH, BASE_B)
	
//Layers - Commented Out
//	COMBO(num-shift, &macro_shift_num, 11 31)
//	COMBO(num-toggle, &mo NUM, 0 14)

//Home Row Combos
	COMBO(ca-left, 12 13, &kp LC(LALT), BASE BASE_B)
	COMBO(cs-left, 11 13, &kp LC(LSHIFT), BASE BASE_B)
	COMBO(as-left, 11 12, &kp LS(LALT), BASE BASE_B)
	COMBO(ca-right, 16 17, &kp RC(RALT), BASE BASE_B)
	COMBO(cs-right, 16 18, &kp RC(RSHIFT), BASE BASE_B)
	COMBO(as-right, 17 18, &kp RS(RALT), BASE BASE_B)

    // left-hand side combos
        // COMBO(quit, 1 2, &kp LG(Q), BASE)
        // COMBO(cltab, 2 3, &kp LG(W), BASE)
        //COMBO(esc, 21 22, &kp ESCAPE, BASE BASE_B)
        //COMBO(copy, 21 22, &kp LG(C), BASE)
        //COMBO(paste, 22 23, &kp LG(V), BASE)
        //COMBO(cut, 21 22 23, &kp LG(X), BASE)
        //COMBO(undo, 10 11, &kp LG(Z), BASE)
        //COMBO(redo, 13 14, &kp LG(LS(Z)), BASE)
    // right-hand side combos
        // COMBO(ret, 16 17 18, &kp RET, BASE)
        // parenthesis combos
        //COMBO(lpar, 16 17, &kp LPAR, BASE BASE_WIN SYM SYMW NUM)
        //COMBO(rpar, 17 18, &kp RPAR, BASE BASE_WIN SYM SYMW NUM)
        // brackets combos
        //COMBO(lbkt, 26 27, &kp LBKT, BASE BASE_WIN SYM SYMW NUM)
        //COMBO(rbkt, 27 28, &kp RBKT, BASE BASE_WIN SYM SYMW NUM)
        // braces combos
        // COMBO(lbrc, 26 27, &kp LBRC, BASE NUM)
        // COMBO(rbrc, 27 28, &kp RBRC, BASE NUM)
        // delete actions
        //COMBO(bspc, 6 7, &kp BSPC, BASE BASE_WIN NAV NAVW NUM)
        //COMBO(del, 7 8, &kp DEL, BASE BASE_WIN NAV NAVW NUM)
        //COMBO(del_word, 6 7 8, &kp LA(BSPC), BASE)
        //COMBO(del_line, 6 7 8, &del_line, NAV)
        //COMBO(del_word_win, 6 7 8, &kp LC(BSPC), BASE_WIN)
        //COMBO(del_line_win, 6 7 8, &del_line_win, NAVW)
        // lock layer
        //COMBO(lock, 0 9 32 33, &tog LOCKL, BASE)
        combo_numshift {
            timeout-ms = <50>;
            key-positions = <11 31>;
            bindings = <&macro_shift_num>;
	    };
    };
};
