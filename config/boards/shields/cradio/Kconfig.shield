## config/boards/shields/cradio/Kconfig.shield
```kconfig
# Copyright (c) 2020 The ZMK Contributors
# SPDX-License-Identifier: MIT

config SHIELD_CRADIO_DONGLE
    def_bool $(shields_list_contains,cradio_dongle)

#unsure whether to comment these out
 config SHIELD_CRADIO_LEFT
     def_bool $(shields_list_contains,cradio_left)

 config SHIELD_CRADIO_RIGHT
     def_bool $(shields_list_contains,cradio_right)
```
